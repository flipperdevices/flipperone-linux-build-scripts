// SPDX-License-Identifier: (GPL-2.0+ OR MIT)
/*
 * Copyright (c) 2024 Luckfox Technology Co., Ltd.
 *
 */

&pwm0_2ch_0 {
	compatible = "rockchip,remotectl-pwm-v4";
	pinctrl-names = "default";
	pinctrl-0 = <&pwm0m0_ch0>;
	remote_pwm_id = <0>;
	handle_cpu_id = <1>;
	remote_support_psci = <0>;
	status = "okay";

	ir_key1 {
		rockchip,usercode = <0xbf00>;
		rockchip,key_table =
			<0xb7	KEY_BACK>,
			<0xe9	KEY_UP>,
			<0xe8	KEY_DOWN>,
			<0xe6	KEY_LEFT>,
			<0xe7	KEY_RIGHT>,
			<0x6b	KEY_HOME>,
			<0xbb	KEY_VOLUMEUP>,
			<0xbc	KEY_VOLUMEDOWN>,
			<0xf2	KEY_POWER>,
            <0xea	KEY_ENTER>,
			<0xeb	KEY_MENU>;
	};
};
